## meta-onekiwi/conf/machine/onekiwi-rzv2h-4gb.conf
```bitbake
#@TYPE: Machine
#@NAME: onekiwi-rzv2h-4gb machine
#@DESCRIPTION: OneKiwi RZ/V2H SOM, 4GB LPDDR4 (2 x 2GB banks)

require conf/machine/include/rzv2h-family.inc
require conf/machine/include/arm/armv8-2a/tune-cortexa55.inc
require conf/machine/include/rz-common.inc

SERIAL_CONSOLES ?= "115200;ttySC0"
PREFERRED_VERSION_trusted-firmware-a ?= "2.10%"
TFA_PLATFORM ?= "v2h"
# OneKiwi LPDDR4 setting: the 4GB board uses the same setting as 8GB
# (renesas-rz-atf-4: plat/renesas/rz/board/v2h_onekiwi_8gb)
TFA_BOARD ?= "onekiwi_8gb"
TFA_UBOOT ?= "1"
TFA_BUILD_TARGET ?= "bl2 fip"
BL2_BOOT_TARGET ?= "spi mmc esd"
EXTRA_IMAGEDEPENDS += " firmware-pack"

BL2_BASE_ADDR ?= "0x08103000"
BL2_ADJUST_VMA ?= "0x08101E00"
FIP_ADJUST_VMA ?= "0x0"

# U-Boot Configuration
PREFERRED_VERSION_u-boot ?= "v2024.07%"
UBOOT_CONFIG ??= "onekiwi-rzv2h-4gb"
UBOOT_CONFIG[onekiwi-rzv2h-4gb] = "onekiwi-rzv2h-4gb_defconfig"

# flash writer
EXTRA_IMAGEDEPENDS += " flash-writer"

# firmware pack
EXTRA_IMAGEDEPENDS += " firmware-pack"

# Supported devicetree
KERNEL_DEVICETREE = " \
	renesas/onekiwi-rzv2h-4gb.dtb \
"

IMAGE_BOOT_FILES = " \
	bl2_bp_spi-${MACHINE}.bin \
	bl2_bp_spi-${MACHINE}.srec \
	bl2_bp_mmc-${MACHINE}.bin \
	bl2_bp_mmc-${MACHINE}.srec \
	fip-${MACHINE}.bin \
	fip-${MACHINE}.srec \
	Flash_Writer_SCIF_RZV2H_DEV_INTERNAL_MEMORY.mot \
"

# Wic image
WKS_FILE = "rz-image-bootpart-esd.wks"
do_image_wic[depends] += "firmware-pack:do_deploy"
```
